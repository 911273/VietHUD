// Driving-alert SOUND logic — the chimes and Vietnamese voice lines for GPS
// ready/lost, overspeed, speed-limit change ahead, camera ahead, resident
// area / no-overtaking / toll / traffic light / hazard, tunnel. Moved out of
// ui/Dashboard.cpp (2026-10-12) so every model gets the same alerts whatever
// its screen: the LVGL dashboards and the Lite's plain-GFX screen both call
// alertAudioTick() from their refresh. Edge detection lives here; the visuals
// stay in each UI.
#include "AlertAudio.h"
#include "core/AppConfig.h"
#include "audio/AudioPlayer.h"
#include "map/SdCardManager.h"
#include <Arduino.h>
#include <math.h>

// Queues the numbered voice clip for kmh (data/speedmap/sounds/vi/speed/
// <N>.mp3) — ONLY if it exactly matches one of the values actually staged
// there (Task C/E, 2026-09-21). Deliberately does not round/approximate to
// the nearest available number: speaking "80" for an actual 82 km/h limit
// would be misinformation, not a rounding nicety, so an unmatched value
// just gets no spoken number (the tone chime + on-screen text still show
// it exactly).
// Full-sentence prompts (2026-09-28, user request: "Gioi han toc do tiep theo
// la 50 km/h", "Phia truoc co camera giam sat toc do..."), generated by
// tools/gen_voice_prompts.py into /speedmap/sounds/vi/: speed_next/<N>.mp3,
// camera_limit/<N>.mp3, camera_ahead.mp3 — one natural utterance per alert
// instead of two stitched clips. Cards without them keep the old prompts.
static const int kPromptSpeeds[] = {20, 30, 35, 40, 45, 50, 60, 70, 80, 90, 100, 110, 120};
static bool promptSpeedKnown(int kmh) {
    for (size_t i = 0; i < sizeof(kPromptSpeeds) / sizeof(kPromptSpeeds[0]); i++)
        if (kPromptSpeeds[i] == kmh) return true;
    return false;
}
// Whether the card has the new prompt set: checked on first use, and again at
// most once a minute while absent (card swapped / files copied later).
static bool newPromptsAvailable() {
    static int8_t sState = -1;
    static uint32_t sCheckedMs = 0;
    if (sState == 1) return true;
    if (sState == 0 && millis() - sCheckedMs < 60000) return false;
    sCheckedMs = millis();
    sState = sdMgrExists("/speedmap/sounds/vi/camera_ahead.mp3") ? 1 : 0;
    Serial.printf("[audio] full-sentence prompts %s\n", sState ? "found" : "not on card (using old prompts)");
    return sState == 1;
}
// Second generated set (2026-10-01): one-clip prompts for overspeed, resident
// area, no-overtaking, toll, light, hazard and tunnel, same voice as the set
// above (tools/gen_voice_prompts.py). tunnel_ahead.mp3 marks the set; same
// check-once / recheck-a-minute rule as newPromptsAvailable().
static bool alertPromptsAvailable() {
    static int8_t sState = -1;
    static uint32_t sCheckedMs = 0;
    if (sState == 1) return true;
    if (sState == 0 && millis() - sCheckedMs < 60000) return false;
    sCheckedMs = millis();
    sState = sdMgrExists("/speedmap/sounds/vi/tunnel_ahead.mp3") ? 1 : 0;
    Serial.printf("[audio] alert prompts %s\n", sState ? "found" : "not on card (using old prompts)");
    return sState == 1;
}
// Queues `generated` when the card has the 2026-10-01 set, else `legacy`.
static void queueAlertVoice(const char *generated, const char *legacy) {
    audioQueueVoice(alertPromptsAvailable() ? generated : legacy);
}
// "Giới hạn tốc độ tiếp theo là N km/h". false -> caller plays the old prompt.
static bool queueNextLimitPrompt(float kmh) {
    int k = (int)lroundf(kmh);
    if (!promptSpeedKnown(k) || !newPromptsAvailable()) return false;
    char f[32];
    snprintf(f, sizeof(f), "speed_next/%d.mp3", k);
    audioQueueVoice(f);
    return true;
}
// "Phía trước có camera giám sát tốc độ[, giới hạn N km/h]". false -> old prompt.
static bool queueCameraPrompt(float limitKmh) {
    if (!newPromptsAvailable()) return false;
    int k = (int)lroundf(limitKmh);
    if (limitKmh > 0 && promptSpeedKnown(k)) {
        char f[32];
        snprintf(f, sizeof(f), "camera_limit/%d.mp3", k);
        audioQueueVoice(f);
    } else {
        audioQueueVoice("camera_ahead.mp3");
    }
    return true;
}

static void queueSpeedVoice(float kmh) {
    static const int kKnownSpeeds[] = {20, 30, 35, 40, 45, 50, 60, 70, 80, 90, 100, 120};
    int kmhInt = (int)lroundf(kmh);
    for (size_t i = 0; i < sizeof(kKnownSpeeds) / sizeof(kKnownSpeeds[0]); i++) {
        if (kKnownSpeeds[i] == kmhInt) {
            char speedFile[24];
            snprintf(speedFile, sizeof(speedFile), "speed/%d.mp3", kmhInt);
            audioQueueVoice(speedFile);
            return;
        }
    }
}

bool alertIsSpeeding(const GnssSnapshot &gnss, const RoadInfoSnapshot &road) {
    // User requirement: độ lệch cảnh báo quá tốc độ là 1km, cứ lớn hơn là cảnh báo
    float overspeedThreshold = road.speedLimitKmh + cfg.overspeedOffsetKmh;
    return road.valid && gnss.fix && road.speedLimitKmh > 0 && (gnss.egoSpeedKmh > overspeedThreshold);
}

void alertAudioTick(const GnssSnapshot &gnss, const RoadInfoSnapshot &road, bool speeding) {
    float overspeedThreshold = road.speedLimitKmh + cfg.overspeedOffsetKmh;
    // GPS status chimes (2026-09-25): a friendly ascending motif the first time
    // a fix is acquired ("device ready"), and a low descending tone if the fix
    // drops WHILE DRIVING. Edge-detected on gnss.fix (already debounced by
    // GNSS.cpp's gnssFixTimeoutS). The "lost" tone only fires if the vehicle
    // actually moved during this fix session (sMovedThisFix) — so a bench with
    // no antenna, or a parked car, doesn't cry wolf. A 3s cooldown stops any
    // marginal-signal toggling from spamming the speaker.
    {
        static int sLastFix = -1; // -1 = first evaluation, no edge yet
        static uint32_t sLastGpsChimeMs = 0;
        static bool sMovedThisFix = false;
        int fixNow = gnss.fix ? 1 : 0;
        if (fixNow && gnss.egoSpeedKmh > 5.0f) sMovedThisFix = true;
        if (sLastFix != -1 && fixNow != sLastFix && millis() - sLastGpsChimeMs > 3000 && cfg.audioSystem) {
            if (fixNow) {
                audioPlayGpsReady();
                sLastGpsChimeMs = millis();
                sMovedThisFix = false; // new fix session
            } else if (sMovedThisFix) {
                audioPlayGpsLost();
                sLastGpsChimeMs = millis();
            }
        }
        sLastFix = fixNow;
    }

    // Audio overspeed chime & voice alert
    static bool lastSpeeding = false;
    static uint32_t lastSpeedingAudioMs = 0;
    if (speeding) {
        uint32_t now = millis();
        if (cfg.audioOverspeed && (!lastSpeeding || (now - lastSpeedingAudioMs > 8000))) {
            lastSpeedingAudioMs = now;
            audioPlayOverspeedAlert();
            queueAlertVoice("overspeed.mp3", "slowdown/voice.mp3");
        }
    }
    if (speeding != lastSpeeding)
        Serial.printf("[speed] %s v=%.0f lim=%d thr=%.0f\n", speeding ? "OVER" : "ok", (double)gnss.egoSpeedKmh,
                      (int)road.speedLimitKmh, (double)overspeedThreshold);
    lastSpeeding = speeding;

    // Upcoming speed-limit-change banner (see aheadLimitLabel's own
    // declaration comment) — gated on an actual state CHANGE (visibility
    // OR the number itself), same discipline as every other banner/flash
    // in this function, not just set unconditionally every 150ms tick.
    static bool lastAheadVisible = false;
    static float lastAheadLimit = -1;
    if (road.aheadLimitValid != lastAheadVisible || road.aheadSpeedLimitKmh != lastAheadLimit) {
        bool newlyVisible = (road.aheadLimitValid && !lastAheadVisible);
        lastAheadVisible = road.aheadLimitValid;
        lastAheadLimit = road.aheadSpeedLimitKmh;
        // Visual is the trafficCard (W_AHEAD_LIMIT); this block only fires the
        // audio cue when a speed-limit change first appears ahead.
        if (road.aheadLimitValid && newlyVisible && cfg.audioLimitAhead) {
            audioPlaySignNotice();
            if (!queueNextLimitPrompt(road.aheadSpeedLimitKmh)) {
                audioQueueVoice("tocdogioihan.mp3");
                queueSpeedVoice(road.aheadSpeedLimitKmh);
            }
        }
    }

    // Speed-camera-ahead banner with audio chime trigger
    static bool lastCameraVisible = false;
    static float lastCameraDist = -1;
    if (road.cameraAheadValid != lastCameraVisible || fabsf(road.cameraAheadDistanceM - lastCameraDist) > 5.0f) {
        bool newlyVisible = (road.cameraAheadValid && !lastCameraVisible);
        lastCameraVisible = road.cameraAheadValid;
        lastCameraDist = road.cameraAheadDistanceM;
        // Visual is the trafficCard (W_CAMERA); this block only fires the audio
        // cue when a camera first appears ahead.
        if (road.cameraAheadValid && newlyVisible && cfg.audioCamera) {
            audioPlayCameraAlert(); // immediate tone chime — cheap, instant, plays while the voice line below queues
            if (!queueCameraPrompt(road.cameraSpeedLimitKmh)) {
                audioQueueVoice("speedcamera.mp3");
                if (road.cameraSpeedLimitKmh >= 0) queueSpeedVoice(road.cameraSpeedLimitKmh);
            }
        }
    }

    // Traffic sign banner (Khu dan cu, Cam vuot, Tram thu phi, Den tin hieu)
    static bool lastSignVisible = false;
    static int lastSignType = 0;
    static float lastSignDist = -1;

    bool signVisible = road.residentAreaAheadValid || road.noOvertakingAheadValid ||
                       road.tollBoothAheadValid || road.trafficLightAheadValid || road.dangerAheadValid;

    int currentSignType = 0;
    float currentSignDist = -1;

    if (road.residentAreaAheadValid) {
        currentSignType = 2;
        currentSignDist = road.residentAreaAheadDistM;
    } else if (road.noOvertakingAheadValid) {
        currentSignType = 3;
        currentSignDist = road.noOvertakingAheadDistM;
    } else if (road.tollBoothAheadValid) {
        currentSignType = 5;
        currentSignDist = road.tollBoothAheadDistM;
    } else if (road.trafficLightAheadValid) {
        currentSignType = 6;
        currentSignDist = road.trafficLightAheadDistM;
    } else if (road.dangerAheadValid) {
        currentSignType = 10;
        currentSignDist = road.dangerAheadDistM;
    }

    if (signVisible != lastSignVisible || currentSignType != lastSignType ||
        fabsf(currentSignDist - lastSignDist) > 5.0f) {
        bool newlyVisible = (signVisible && !lastSignVisible);
        lastSignVisible = signVisible;
        lastSignType = currentSignType;
        lastSignDist = currentSignDist;

        // Visual is the trafficCard (W_RESIDENT/W_NO_OVERTAKE/W_TOLL/W_LIGHT/
        // W_DANGER, icon + distance); this block only fires the audio cue when a
        // sign first appears ahead.
        bool typeAudio = (currentSignType == 2 && cfg.audioResident) || (currentSignType == 3 && cfg.audioNoOvertake) ||
                         (currentSignType == 5 && cfg.audioToll) || (currentSignType == 6 && cfg.audioLight) ||
                         (currentSignType == 10 && cfg.audioDanger);
        if (signVisible && newlyVisible && typeAudio) {
            audioPlaySignNotice(); // immediate tone chime — cheap, instant, plays while the voice line below queues
            // Only resident-area/no-overtaking/toll/traffic-light/danger have
            // a matching voice asset in data/speedmap/sounds/vi/ — no fallback
            // fabricated for anything else; see AudioPlayer.h.
            switch (currentSignType) {
                case 2:
                    if (road.residentAreaIsStart) queueAlertVoice("resident_start.mp3", "batdaukhudancu.mp3");
                    else queueAlertVoice("resident_end.mp3", "hetkhudongdancu.mp3");
                    break;
                case 3:
                    if (road.noOvertakingIsStart) queueAlertVoice("no_overtake_start.mp3", "camvuot.mp3");
                    else queueAlertVoice("no_overtake_end.mp3", "hetcamvuot.mp3");
                    break;
                case 5: queueAlertVoice("toll_ahead.mp3", "tramthuphi.mp3"); break;
                case 6: queueAlertVoice("light_ahead.mp3", "chuydentinhieugiaothong.mp3"); break;
                case 10: queueAlertVoice("danger_ahead.mp3", "sapdenbienbao.mp3"); break; // generic hazard zone
                default: break;
            }
        }
    }

    // Tunnel entrance ahead (2026-10-01) — from the route's SEGFLAG_TUNNEL, not
    // a sign point, so it has its own edge detector. Uses the hazard toggle
    // (cfg.audioDanger) rather than a new setting.
    // 30 s cooldown: a route rebuild/fork flicker must not repeat the line.
    static bool lastTunnelVisible = false;
    static uint32_t lastTunnelAudioMs = 0;
    if (road.tunnelAheadValid != lastTunnelVisible) {
        lastTunnelVisible = road.tunnelAheadValid;
        if (road.tunnelAheadValid && cfg.audioDanger &&
            (lastTunnelAudioMs == 0 || millis() - lastTunnelAudioMs > 30000)) {
            lastTunnelAudioMs = millis();
            audioPlaySignNotice();
            queueAlertVoice("tunnel_ahead.mp3", "sapdencuaham.mp3");
        }
    }
}
